# file: practica-3.ioc
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Mcu.Family=STM32F4
Mcu.Name=STM32F429ZITx
Mcu.Package=LQFP144
NVIC.PriorityGroup=NVIC_PRIORITYGROUP_4
ProjectManager.HeapSize=0x200
ProjectManager.StackSize=0x400
ProjectManager.TargetToolchain=STM32CubeIDE
RCC.AHBFreq_Value=16000000
RCC.APB1Freq_Value=16000000
RCC.APB2Freq_Value=16000000
RCC.CortexFreq_Value=16000000
RCC.HSE_VALUE=25000000
RCC.HSI_VALUE=16000000
RCC.LSE_VALUE=32768
RCC.SYSCLKFreq_VALUE=16000000
RCC.VCOOutputFreq_Value=192000000
board=custom

// file: Core/Src/main.c
/* USER CODE BEGIN Header */
/**
  ******************************************************************************
  * @file           : main.c
  * @brief          : Main program body
  ******************************************************************************
  * @attention
  *
  * Copyright (c) 2024 STMicroelectronics.
  * All rights reserved.
  *
  * This software is licensed under terms that can be found in the LICENSE file
  * in the root directory of this software component.
  * If no LICENSE file comes with this software, it is provided AS-IS.
  *
  ******************************************************************************
  */
/* USER CODE END Header */
#include "main.h"
#include "asm_func.h"

/* USER CODE BEGIN PD */
#define CANTIDAD_SAMPLES 4096U
/* USER CODE END PD */

void SystemClock_Config(void);

int main(void)
{

  /* MCU Configuration--------------------------------------------------------*/

  /* Reset of all peripherals, Initializes the Flash interface and the Systick. */
  HAL_Init();

  /* Configure the system clock */
  SystemClock_Config();

  /* Initialize all configured peripherals */
  /* USER CODE BEGIN 2 */

  int16_t vecIn[]     = {1, 2, 3, 4, 5, 6, -10, 2000};
  uint32_t longitud1  = sizeof(vecIn) / sizeof(vecIn[0]);

  uint32_t potencia      = asm_potencia(vecIn, longitud1);
  uint32_t potencia_DSP  = asm_potencia_DSP(vecIn, longitud1);

  int32_t resta1 = potencia - potencia_DSP;
  (void)resta1;

  int8_t x[] = {10, 20, 30, 40, 10, 20, 30, 40};
  int8_t y[] = { 5, 15, 25, 35,  5, 15, 25, 35};

  uint16_t longitud2 = sizeof(x) / sizeof(x[0]);
  int8_t e[longitud2];
  int8_t e_DSP[longitud2];
  int8_t e_diff[longitud2];

  asm_medDif(e, x, y, longitud2);
  asm_medDif_DSP(e_DSP, x, y, longitud2);

  for (uint16_t i = 0; i < longitud2; i++)
  {
    e_diff[i] = e[i] - e_DSP[i];
  }
  (void)e_diff;

  //int16_t signal[] = {100, 200, 300, 400, 500, 600, 700, 800, 900, 1000};
  int16_t signal[CANTIDAD_SAMPLES];

  for(uint16_t i = 0u; i < CANTIDAD_SAMPLES; i++)
  {
	  signal[i] = 0x10;
  }
  uint32_t longitud3 = sizeof(signal) / sizeof(signal[0]);
  int16_t eco[CANTIDAD_SAMPLES];
  int16_t eco_DSP[CANTIDAD_SAMPLES];
  int32_t eco_diff[CANTIDAD_SAMPLES];

  asm_eco(signal, eco, longitud3);
  asm_eco_DSP(signal, eco_DSP, longitud3);

  for (uint16_t i = 0u; i < longitud3; i++)
  {
    eco_diff[i] = eco[i] - eco_DSP[i];
    if (0u != eco_diff[i])
    {
      (void)eco_diff[i]; // poner break
    }
  }
  (void)eco_diff;
  /* USER CODE END 2 */

  /* Infinite loop */
  while (1)
  {

  }
}

void SystemClock_Config(void)
{
  RCC_OscInitTypeDef RCC_OscInitStruct = {0};
  RCC_ClkInitTypeDef RCC_ClkInitStruct = {0};

  /** Configure the main internal regulator output voltage
  */
  __HAL_RCC_PWR_CLK_ENABLE();
  __HAL_PWR_VOLTAGESCALING_CONFIG(PWR_REGULATOR_VOLTAGE_SCALE3);

  /** Initializes the RCC Oscillators according to the specified parameters
  * in the RCC_OscInitTypeDef structure.
  */
  RCC_OscInitStruct.OscillatorType = RCC_OSCILLATORTYPE_HSI;
  RCC_OscInitStruct.HSIState = RCC_HSI_ON;
  RCC_OscInitStruct.HSICalibrationValue = RCC_HSICALIBRATION_DEFAULT;
  RCC_OscInitStruct.PLL.PLLState = RCC_PLL_NONE;
  if (HAL_RCC_OscConfig(&RCC_OscInitStruct) != HAL_OK)
  {
    Error_Handler();
  }

  /** Initializes the CPU, AHB and APB buses clocks
  */
  RCC_ClkInitStruct.ClockType = RCC_CLOCKTYPE_HCLK|RCC_CLOCKTYPE_SYSCLK
                              |RCC_CLOCKTYPE_PCLK1|RCC_CLOCKTYPE_PCLK2;
  RCC_ClkInitStruct.SYSCLKSource = RCC_SYSCLKSOURCE_HSI;
  RCC_ClkInitStruct.AHBCLKDivider = RCC_SYSCLK_DIV1;
  RCC_ClkInitStruct.APB1CLKDivider = RCC_HCLK_DIV1;
  RCC_ClkInitStruct.APB2CLKDivider = RCC_HCLK_DIV1;

  if (HAL_RCC_ClockConfig(&RCC_ClkInitStruct, FLASH_LATENCY_0) != HAL_OK)
  {
    Error_Handler();
  }
}

void Error_Handler(void)
{
  __disable_irq();
  while (1)
  {
  }
}
